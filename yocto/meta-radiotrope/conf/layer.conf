## yocto/meta-radiotrope/conf/layer.conf
```bitbake
# Layer configuration for meta-radiotrope
BBPATH .= ":${LAYERDIR}"
BBFILES += "${LAYERDIR}/recipes-*/*/*.bb ${LAYERDIR}/recipes-*/*/*.bbappend"
BBFILE_COLLECTIONS += "radiotrope"
BBFILE_PATTERN_radiotrope = "^${LAYERDIR}/"
BBFILE_PRIORITY_radiotrope = "10"

LAYERDEPENDS_radiotrope = "core raspberrypi rust-bin-layer"
LAYERSERIES_COMPAT_radiotrope = "scarthgap"
```
