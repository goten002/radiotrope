/dts-v1/;
/plugin/;

/ {
	compatible = "brcm,bcm2835";

	fragment@0 {
		target-path = "/";
		__overlay__ {
			gpio-keys {
				compatible = "gpio-keys";
				#address-cells = <1>;
				#size-cells = <0>;

				power-button {
					label = "power";
					linux,code = <116>; /* KEY_POWER */
					gpios = <&gpio 4 1>; /* GPIO 4, active low */
					debounce-interval = <100>;
				};
			};
		};
	};
};
